## CMakeLists.txt
```
cmake_minimum_required(VERSION 3.20.0)

find_package(Zephyr REQUIRED HINTS $ENV{ZEPHYR_BASE})
project(nrf52840_rtos_adc)

FILE(GLOB app_sources src/*.c)
target_sources(app PRIVATE ${app_sources})
```

## prj.conf
```kconfig
# Debugger Support
CONFIG_UART_CONSOLE=n
CONFIG_CONSOLE=y
CONFIG_SERIAL=y

# RTT Segger Support
CONFIG_RTT_CONSOLE=y
CONFIG_USE_SEGGER_RTT=y
CONFIG_LOG_BACKEND_RTT=y

# Communication Bus Support
CONFIG_GPIO=y
CONFIG_SPI=y
CONFIG_I2C=y

# Hardware Support
CONFIG_ADC=y

# RTC Support
CONFIG_RTC=y
CONFIG_COUNTER=y
CONFIG_CLOCK_CONTROL=y
CONFIG_COUNTER_MAXIM_DS3231=y

# Flash Memory Support (MX25R64)
CONFIG_FLASH=y
CONFIG_MPU_ALLOW_FLASH_WRITE=y
CONFIG_NORDIC_QSPI_NOR=y
```

## boards/mdbt50q_lora_dev.overlay
```dts
/*
 * Copyright (c) 2025
 * Regis Rousseau
 * Univ Lyon, INSA Lyon, Inria, CITI, EA3720
 * SPDX-License-Identifier: Apache-2.0
 */

/* Sismic sensor analog value conversion */
/* external ADC channnel of MDBT50Q, Port P0.02 on schematic */
/ {
	zephyr,user {
		io-channels = <&adc 0>;
	};
};

/* enable the corresponding ADC, with the correct configuration */
&adc {
	#address-cells = <1>;
	#size-cells = <0>;
	status = "okay";
	channel@0 {
		reg = <0>;											/* channel 0 of the ADC */
		zephyr,gain = "ADC_GAIN_1_6";						/* attenuated by 6 (x1/6) */
		zephyr,reference = "ADC_REF_INTERNAL";				/* reference voltage +0.6 */
		zephyr,acquisition-time = <ADC_ACQ_TIME_DEFAULT>;	/* 10us */
		zephyr,input-positive = <NRF_SAADC_AIN0>;			/* P0.02 for nRF52xx */
		zephyr,resolution = <12>;
	};
};
```

## src/main.c
```c
/*
 * Copyright (c) 2025
 * Regis Rousseau
 * Univ Lyon, INSA Lyon, Inria, CITI, EA3720
 * SPDX-License-Identifier: Apache-2.0
 */

//  ========== includes ====================================================================
#include "app_eeprom.h"
#include "app_adc.h"
#include "app_rtc.h"
#include "app_ds3231.h"

#include <zephyr/kernel.h>
#include <stdbool.h>
#include <stdio.h>

//  ========== defines =====================================================================
#define STACK_SIZE 2048
#define PRIORITY   2

//  ========== globals =====================================================================
bool rtc_thread_flag = true;
void rtc_thread_func(void)
{
	printk("periodic sync thread started\n");

	const struct device *rtc_dev = DEVICE_DT_GET(DT_NODELABEL(rtc0));
	const struct device *ds3231_dev = DEVICE_DT_GET_ONE(maxim_ds3231);
	while (rtc_thread_flag == true) {
        printk("performing periodic action\n");
    //    (void)app_rtc_periodic_sync(rtc_dev);
	//	(void)app_ds3231_periodic_sync(ds3231_dev);
        k_sleep(K_SECONDS(1));		
	}
}
K_THREAD_DEFINE(rtc_thread_id, STACK_SIZE, rtc_thread_func, NULL, NULL, NULL, PRIORITY, 0, 0);

//  ========== interrupt sub-routine =================================================================
void geo_work_handler(struct k_work *work_geo)
{
// 	const struct device *rom_dev = DEVICE_DT_GET(SPI_FLASH_DEVICE);

// 	printk("ADC handler called\n");
// 	app_eeprom_handler(rom_dev);

	printk("test only sensor connected on ADC P0.03\n");
	int16_t value = app_nrf52_get_adc();
	printk("return velocity: %d mV\n", value);

	// printk("test only internal and DS3231 RTC device\n");

	// uint64_t timestamp_rtc =  app_rtc_get_time();
	// printk("timestamp in ms (RTC): %llu\n", timestamp_rtc);

	// uint64_t timestamp_ds3231 = app_ds3231_get_time();
	// printk("timestamp in ms (DS3231): %llu\n", timestamp_ds3231);
}
K_WORK_DEFINE(geo_work, geo_work_handler);

void geo_timer_handler(struct k_timer *geo_dum)
{
	k_work_submit(&geo_work);
}
K_TIMER_DEFINE(geo_timer, geo_timer_handler, NULL);

// ========== main ===================================================================================
int8_t main(void)
{
	// initialize DS3231 RTC device via I2C (Pins: SDA -> P0.09, SCL -> P0.0)
	const struct device *ds3231_dev = app_ds3231_init();
    if (!ds3231_dev) {
        printk("failed to initialize RTC device\n");
        return 0;
    } else {
		app_ds3231_set_time(ds3231_dev, 1721390400); // set to "2024-07-19 12:00:00" UTC
	}

	// initialize on-board RTC of MDBT50Q
	const struct device *rtc_dev = app_rtc_init();
    if (!rtc_dev) {
        printk("failed to initialize RTC device\n");
        return 0;
    } else {
		app_rtc_set_time(rtc_dev, 1721050200000ULL); // e.g., for "2024-07-15 12:30:00 UTC" in ms
	}

	// initialize ADC device
	int8_t ret = app_nrf52_adc_init();
	if (ret != 1) {
		printk("failed to initialize ADC device\n");
		return 0;
	}

	// retrieve the EEPROM device
	const struct device *flash_dev = DEVICE_DT_GET(SPI_FLASH_DEVICE);
	ret = app_eeprom_init(flash_dev);
	if (ret != 1) {
		printk("failed to initialize QSPI Flash device\n");
		return 0;
	}

	printk("ADC nRF52 and RTC DS3231 Example\n");

	// enable periodic rtc sync thread
	rtc_thread_flag = false;

	// start the timer to trigger the interrupt subroutine every 30 seconds
	k_timer_start(&geo_timer, K_NO_WAIT, K_MSEC(5000));
	return 0;
}
```

## src/app_adc.c
```c
/*
 * Copyright (c) 2025
 * Regis Rousseau
 * Univ Lyon, INSA Lyon, Inria, CITI, EA3720
 * SPDX-License-Identifier: Apache-2.0
 */

//  ========== includes ====================================================================
#include "app_adc.h"

//  ========== globals =====================================================================
// ADC buffer to store raw ADC readings
int16_t buf;

// ADC channel configuration obtained from the device tree
static const struct adc_dt_spec adc_channel = ADC_DT_SPEC_GET(DT_PATH(zephyr_user));

// ADC sequence configuration to specify the ADC operation
static struct adc_sequence sequence = {
    .channels = 1,
	.buffer = &buf,
	.buffer_size = sizeof(buf),
};

//  ========== app_nrf52_adc_init ==========================================================
int8_t app_nrf52_adc_init()
{
    int8_t ret;

    // verify if the ADC is ready for operation
    if (!adc_is_ready_dt(&adc_channel)) {
		printk("ADC is not ready. error: %d\n", ret);
		return 0;
    }
    
    // configure the ADC channel settings
    ret = adc_channel_setup_dt(&adc_channel);
	if (ret < 0) {
		printk("failed to set up ADC channel. error: %d\n", ret);
		return 0;
	}

    // Initialize the ADC sequence for continuous or single readings
    ret = adc_sequence_init_dt(&adc_channel, &sequence);
	if (ret < 0) {
		printk("failed to initialize ADC sequence. error: %d\n", ret);
		return 0;
	}
    return 1;
}

//  ========== app_nrf52_get_adc ===========================================================
int16_t app_nrf52_get_adc()
{
    int16_t velocity;       // converted voltage value in mV
    int8_t ret;
    
    // trigger an ADC read and store the result in the configured buffer
    ret = adc_read(adc_channel.dev, &sequence);
    if (ret < 0) {        
	    printk("failed to read raw ADC value. Error: %d\n", ret);
	    return 0;
    }

    printk("raw adc value: %d\n", buf);

    // convert the raw ADC reading into a voltage value (in millivolts)
    velocity = (buf * ADC_REFERENCE_VOLTAGE) / ADC_RESOLUTION;
    printk("velocity: %d mV\n", velocity);
    return (int16_t)velocity;
}
```

## src/app_adc.h
```c
/*
 * Copyright (c) 2025
 * Regis Rousseau
 * Univ Lyon, INSA Lyon, Inria, CITI, EA3720
 * SPDX-License-Identifier: Apache-2.0
 */

#ifndef APP_ADC_H
#define APP_ADC_H

//  ========== includes ====================================================================
#include <zephyr/kernel.h>
#include <zephyr/device.h>
#include <zephyr/devicetree.h>
#include <zephyr/drivers/adc.h>

//  ========== defines =====================================================================
#define ADC_REFERENCE_VOLTAGE       3300    // 3.3V reference voltage of the board
#define ADC_RESOLUTION              4096    // 12-bit resolution

//  ========== prototypes ==================================================================
int8_t app_nrf52_adc_init();
int16_t app_nrf52_get_adc();

#endif /* APP_ADC_H */
```

## src/app_ds3231.c
```c
/*
 * Copyright (c) 2025
 * Regis Rousseau
 * Univ Lyon, INSA Lyon, Inria, CITI, EA3720
 * SPDX-License-Identifier: Apache-2.0
 */

//  ========== includes ==================================================================
#include "app_ds3231.h"

//  ========== globals ===================================================================
static int64_t system_rtc_offset_ms = 0;
static struct k_mutex offset_mutex;

//  ========== bcd_to_bin ================================================================ 
static uint8_t bcd_to_bin(uint8_t val)
{
    return ((val >> 4) * 10) + (val & 0x0F);
}

// ========== bin_to_bcd =================================================================
static uint8_t bin_to_bcd(uint8_t val)
{
    return ((val / 10) << 4) | (val % 10);
}

// ========== app_i2c_write_time ============================================================
int8_t app_i2c_write_time(const struct device *i2c_dev, const struct tm *tm)
{
    uint8_t time_buf[7];
    int8_t ret;

    if (!i2c_dev || !tm) {
        return -EINVAL;
    }

    time_buf[0] = bin_to_bcd(tm->tm_sec);
    time_buf[1] = bin_to_bcd(tm->tm_min);
    time_buf[2] = bin_to_bcd(tm->tm_hour);
    time_buf[3] = bin_to_bcd(tm->tm_wday + 1);         // struct tm: 0=Sun → DS3231: 1=Sun
    time_buf[4] = bin_to_bcd(tm->tm_mday);
    time_buf[5] = bin_to_bcd(tm->tm_mon + 1);          // struct tm: 0=Jan → DS3231: 1=Jan
    time_buf[6] = bin_to_bcd(tm->tm_year - 100);       // struct tm: years since 1900 → DS3231: years since 2000

    ret = i2c_burst_write(i2c_dev, DS3231_I2C_ADDR, DS3231_REG_TIME, time_buf, sizeof(time_buf));
    if (ret < 0) {
        printk("failed to write time to DS3231: %d\n", ret);
        return ret;
    }

    printk("DS3231 time set successfully\n");
    return 0;
}

//  ========== app_i2c_read_time ========================================================= 
int8_t app_i2c_read_time(const struct device *i2c_dev, struct tm *tm)
{
    uint8_t time_buf[7];
    int8_t ret;

    if (!i2c_dev || !tm) {
        return -EINVAL;
    }

    ret = i2c_burst_read(i2c_dev, DS3231_I2C_ADDR, DS3231_REG_TIME, time_buf, sizeof(time_buf));
    if (ret < 0) {
        printk("failed to read DS3231 registers. error: %d", ret);
        return ret;
    }

    tm->tm_sec  = bcd_to_bin(time_buf[0] & 0x7F);
    tm->tm_min  = bcd_to_bin(time_buf[1] & 0x7F);
    tm->tm_hour = bcd_to_bin(time_buf[2] & 0x3F);  // 24-hour format
    tm->tm_wday = bcd_to_bin(time_buf[3] & 0x07) - 1;  // DS3231: 1=Sun...7=Sat → struct tm: 0=Sun...6=Sat
    tm->tm_mday = bcd_to_bin(time_buf[4] & 0x3F);
    tm->tm_mon  = bcd_to_bin(time_buf[5] & 0x1F) - 1;  // struct tm: 0=Jan
    tm->tm_year = bcd_to_bin(time_buf[6]) + 100;       // since 1900 → 2000 + xx

    return 0;
}

//  ========== app_rtc_init ==============================================================
const struct device *app_ds3231_init(void)
{
    const struct device *i2c_dev = DEVICE_DT_GET_ONE(maxim_ds3231);
    if (!i2c_dev) {
        printk("no DS3231 device found\n");
        return NULL;
    }

    // initialize mutex
    k_mutex_init(&offset_mutex);

    printk("DS3231 initialized and started successfully (device: %s)\n", i2c_dev->name);
    return i2c_dev;
}

//  ========== app_ds3231_set_time =========================================================
void app_ds3231_set_time(const struct device *i2c_dev, int64_t unix_time)
{
    struct tm tm;
    time_t t = (time_t)unix_time;
    gmtime_r(&t, &tm);  
    //timeutil_localtime64(unix_time, &tm);
    app_i2c_write_time(i2c_dev, &tm);
}

//  ========== app_ds3231_sync_uptime ========================================================
// synchronize the system uptime with the DS3231 RTC
int8_t app_ds3231_sync_uptime(const struct device *i2c_dev)
{
    if (!i2c_dev) {
        printk("DS3231 device is NULL\n");
        return -EINVAL;
    }

    struct tm rtc_tm;
    int64_t rtc_epoch_s;
    int64_t rtc_epoch_ms;
    int64_t current_uptime_ms;
    int64_t new_offset_ms;

    // get time from external RTC
    if (app_i2c_read_time(i2c_dev, &rtc_tm) != 0) {
        printk("failed to read time from DS3231\n");
        return -EIO;
    }

    // calculate the offset between RTC time and system uptime
    rtc_epoch_s = timeutil_timegm64(&rtc_tm);
    rtc_epoch_ms = rtc_epoch_s * 1000;
    current_uptime_ms = k_uptime_get();
    new_offset_ms = rtc_epoch_ms - current_uptime_ms;

    // safely update the global offset
    k_mutex_lock(&offset_mutex, K_FOREVER);
    system_rtc_offset_ms = new_offset_ms;
    k_mutex_unlock(&offset_mutex);

    // debugging output
    printk("synced: DS3231 epoch_ms = %lld, uptime = %lld, offset = %lld\n",
           rtc_epoch_ms, current_uptime_ms, new_offset_ms);

    return 0;
}

//  ========== app_rtc_get_time ==========================================================
uint64_t app_ds3231_get_time()
{
    int64_t now_ms = k_uptime_get();
    int64_t offset;

    k_mutex_lock(&offset_mutex, K_FOREVER);
    offset = system_rtc_offset_ms;
    k_mutex_unlock(&offset_mutex);

    // protect against overflow
    if (offset > 0 && now_ms > UINT64_MAX - offset) {
        return UINT64_MAX;
    }
    if (offset < 0 && now_ms < (uint64_t)(-offset)) {
        return 0;
    }
    uint64_t timestamp_ms = now_ms + offset;
    return timestamp_ms;
}

//  ========== app_ds3231_periodic_sync ====================================================
int8_t app_ds3231_periodic_sync(const struct device *i2c_dev)
{
    if (!i2c_dev) {
        printk("RTC device is NULL\n");
        return -EINVAL;
    }
    
    // call this periodically from a thread or workqueue
    int ret = app_ds3231_sync_uptime(i2c_dev);
    if (ret < 0) {
        printk("periodic sync failed, error: %d", ret);
    }
    return 0;
}
```

## src/app_ds3231.h
```c
/*
 * Copyright (c) 2025
 * Regis Rousseau
 * Univ Lyon, INSA Lyon, Inria, CITI, EA3720
 * SPDX-License-Identifier: Apache-2.0
 */

#ifndef APP_DS3231_H
#define APP_DS3231_H

//  ========== includes ====================================================================
#include <zephyr/kernel.h>
#include <zephyr/device.h>
#include <zephyr/devicetree.h>
#include <zephyr/drivers/rtc.h>
#include <zephyr/drivers/counter.h>
#include <zephyr/drivers/i2c.h>
#include <zephyr/sys_clock.h>
#include <time.h>

//  ========== defines =====================================================================
#define ONE_YEAR_MS         31536000000LL
#define DS3231_I2C_ADDR     0x68
#define DS3231_REG_TIME     0x00

//  ========== prototypes ===================================================================
int8_t app_i2c_read_time(const struct device *i2c_dev, struct tm *tm);
int8_t app_i2c_write_time(const struct device *i2c_dev, const struct tm *tm);
const struct device *app_ds3231_init(void);
void app_ds3231_set_time(const struct device *i2c_dev, int64_t unix_time);
int8_t  app_ds3231_sync_uptime(const struct device *i2c_dev);
uint64_t app_ds3231_get_time();
int8_t app_ds3231_periodic_sync(const struct device *i2c_dev);

#endif /* APP_DS3231_H */
```

## src/app_eeprom.c
```c
/*
 * Copyright (c) 2025
 * Regis Rousseau
 * Univ Lyon, INSA Lyon, Inria, CITI, EA3720
 * SPDX-License-Identifier: Apache-2.0
 */

//  ========== includes ====================================================================
#include "app_eeprom.h"
#include "app_rtc.h"

//  ========== serialize_uint64_to_bytes ===================================================
// serialize a uint64_t to bytes
static void serialize_uint64_to_bytes(uint64_t value, uint8_t *buffer) {
    for (int i = 0; i < 8; i++) {
        buffer[i] = (value >> (56 - 8 * i)) & 0xFF;
    }
}

//  ========== deserialize_bytes_to_uint64 ================================================
// deserialize bytes to uint64_t
static uint64_t deserialize_bytes_to_uint64(const uint8_t *buffer) {
    uint64_t value = 0;
    for (int i = 0; i < 8; i++) {
        value |= ((uint64_t)buffer[i] << (56 - 8 * i));
    }
    return value;
}

//  ========== app_eeprom_init =============================================================
int8_t app_eeprom_init(const struct device *dev)
{
	// check if the EEPROM device is ready
	if (!device_is_ready(dev)) {
		printk("%s: device is not ready\n", dev->name);
		return -1;
	}

	// erase the data storage partition
	int8_t ret = flash_erase(dev, SPI_FLASH_OFFSET, SPI_FLASH_SECTOR_SIZE*SPI_FLASH_SECTOR_NB);
	if (ret != 0){
		printf("MX25R64 flash erase failed. error: %d\n", ret);
		return -1;
	} else {
		printk("MX25R64 flash erase succeeded\n");
	}	
	return 1;
}

//  ========== app_eeprom_write ============================================================
// write data to EEPROM
int8_t app_eeprom_write(const struct device *dev, const uint8_t *data, size_t length)
{
    int8_t ret = flash_write(dev, SPI_FLASH_OFFSET, data, length);
    if (ret != 0) {
        printk("Eerror writing data. Error: %d\n", ret);
        return -1;
    }
    printk("successfully wrote %zu bytes to address 0x%X\n", length, SPI_FLASH_OFFSET);
    return 0;
}

//  ========== app_rom_read ================================================================
// Read data from EEPROM
int8_t app_eeprom_read(const struct device *dev, uint8_t *data, size_t length)
{
    int ret = flash_read(dev, SPI_FLASH_OFFSET, data, length);
    if (ret != 0) {
        printk("error reading data. Error: %d\n", ret);
        return -1;
    }
    printk("successfully read %zu bytes from address 0x%X\n", length, SPI_FLASH_OFFSET);
    return 0;
}

//  ======== app_rom_handler ===============================================================
int8_t app_eeprom_handler(const struct device *dev)
{
    uint8_t buffer[256] = {0}; // Enough space for timestamp and ADC data
    int16_t adc_data[MAX_RECORDS] = {0};
    uint64_t timestamp = 0;

    if (!device_is_ready(dev)) {
        printk("%s: device is not ready\n", dev->name);
        return -1;
    }

    // initialize RTC and get the current timestamp
    const struct device *rtc_dev = app_rtc_init();
    if (!rtc_dev) {
        printk("failed to initialize RTC device.\n");
        return -1;
    }
    timestamp = app_rtc_get_time(rtc_dev);

    // serialize timestamp into the buffer
    serialize_uint64_to_bytes(timestamp, buffer);

    // get ADC data and serialize it into the buffer
    for (int i = 0; i < MAX_RECORDS; i++) {
        adc_data[i] = app_nrf52_get_adc();
        buffer[8 + i * 2] = (adc_data[i] >> 8) & 0xFF; // high byte
        buffer[9 + i * 2] = adc_data[i] & 0xFF;        // low byte
    }

    // write buffer to EEPROM
    if (app_eeprom_write(dev, buffer, sizeof(buffer)) != 0) {
        return -1;
    }

    // read back and verify
    uint8_t read_buffer[256] = {0};
    if (app_eeprom_read(dev, read_buffer, sizeof(read_buffer)) != 0) {
        return -1;
    }

    // deserialize timestamp
    uint64_t read_timestamp = deserialize_bytes_to_uint64(read_buffer);
    printk("Read timestamp: %llu\n", read_timestamp);

    // deserialize and print ADC data
    for (int i = 0; i < MAX_RECORDS; i++) {
        int16_t read_adc = (read_buffer[8 + i * 2] << 8) | read_buffer[9 + i * 2];
        printk("Read ADC value [%d]: %d\n", i, read_adc);
    }
    return 0;
}
```

## src/app_eeprom.h
```c
/*
 * Copyright (c) 2025
 * Regis Rousseau
 * Univ Lyon, INSA Lyon, Inria, CITI, EA3720
 * SPDX-License-Identifier: Apache-2.0
 */

#ifndef APP_EEPROM_H
#define APP_EEPROM_H

//  ========== includes ====================================================================
#include <zephyr/kernel.h>
#include <zephyr/device.h>
#include <zephyr/devicetree.h>
#include <zephyr/drivers/flash.h>

//  ========== defines =====================================================================
#define SPI_FLASH_DEVICE        DT_COMPAT_GET_ANY_STATUS_OKAY(nordic_qspi_nor)
#define SPI_FLASH_OFFSET		0x00000
#define SPI_FLASH_SECTOR_SIZE	4096   // in bytes
#define SPI_FLASH_SECTOR_NB     1
#define MAX_RECORDS             128    // max number of ADC records                     

//  ========== prototypes ==================================================================
int8_t app_eeprom_init(const struct device *dev);
int8_t app_eeprom_write(const struct device *dev, const uint8_t *data, size_t length);
int8_t app_eeprom_read(const struct device *dev, uint8_t *data, size_t length);
int8_t app_eeprom_handler(const struct device *dev);
static void serialize_uint64_to_bytes(uint64_t value, uint8_t *buffer);
static uint64_t deserialize_bytes_to_uint64(const uint8_t *buffer);

#endif /* APP_EEPROM_H */
```

## src/app_rtc.c
```c
/*
 * Copyright (c) 2025
 * Regis Rousseau
 * Univ Lyon, INSA Lyon, Inria, CITI, EA3720
 * SPDX-License-Identifier: Apache-2.0
 */

//  ========== includes ==============================================================================
#include "app_rtc.h"

//  ========== globals ===============================================================================
// global variable to track the offset between the system clock and RTC
static int64_t system_rtc_offset_ms = 0;
static struct k_mutex offset_mutex;

//  ========== app_rtc_init ==========================================================================
const struct device *app_rtc_init(void)
{
    const struct device *rtc_dev = DEVICE_DT_GET(DT_NODELABEL(rtc0));
    if (!device_is_ready(rtc_dev)) {
        printk("RTC device is not ready\n");
        return NULL;
    }

    // start the counter
    int8_t ret = counter_start(rtc_dev);
    if (ret < 0) {
        printk("failed to start RTC: %d\n", ret);
        return NULL;
    }

    // initialize mutex
    k_mutex_init(&offset_mutex);

    printk("RTC initialized and started successfully (device: %s)\n", rtc_dev->name);
    return rtc_dev;
}

//  ========== app_rtc_set_time ======================================================================
int8_t app_rtc_set_time(const struct device *rtc_dev, uint64_t target_time_ms)
{
    if (!rtc_dev) {
        printk("RTC device is NULL\n");
        return -EINVAL;
    }

    uint32_t rtc_ticks;
    int8_t ret = counter_get_value(rtc_dev, &rtc_ticks);
    if (ret < 0) {
        printk("failed to read RTC ticks: %d\n", ret);
        return ret;
    }

    uint32_t frequency = counter_get_frequency(rtc_dev);
    int64_t rtc_time_ms = ((int64_t)rtc_ticks * 1000) / frequency;

    int64_t new_offset = (int64_t)target_time_ms - rtc_time_ms;

    // safely update the global offset
    k_mutex_lock(&offset_mutex, K_FOREVER);
    system_rtc_offset_ms = new_offset;
    k_mutex_unlock(&offset_mutex);

    printk("RTC time logically set to %llu ms via offset (%lld ms)\n", target_time_ms, new_offset);
    return 0;
}

//  ========== app_rtc_sync_uptime ===================================================================
// synchronize the system uptime with the on-board RTC.
int8_t app_rtc_sync_uptime(const struct device *rtc_dev)
{
    if (!rtc_dev) {
        printk("RTC device is NULL\n");
        return -EINVAL;
    }

    uint32_t rtc_ticks;
    uint32_t top_value;
    uint32_t frequency;
    int64_t rtc_time_ms;
    int64_t current_uptime_ms;
    int64_t new_offset_ms;

    // get system cycle count before and after RTC read
    uint64_t t1_cycles = k_cycle_get_64();

    // retrieve the current RTC counter value
    int8_t ret = counter_get_value(rtc_dev, &rtc_ticks);
    if (ret < 0) {
        printk("failed to get RTC counter value, error: %d\n", ret);
        return ret;
    }

    uint64_t t2_cycles = k_cycle_get_64();

    // compute midpoint cycle time and convert to milliseconds
    uint64_t mid_cycles = (t1_cycles + t2_cycles) / 2;
    uint64_t sys_clk_hz = sys_clock_hw_cycles_per_sec();
    current_uptime_ms = (mid_cycles * 1000) / sys_clk_hz;

    // get the counter's top value and frequency
    top_value = counter_get_top_value(rtc_dev);
    frequency = counter_get_frequency(rtc_dev);

    // convert the RTC ticks to milliseconds
    rtc_time_ms = ((int64_t)rtc_ticks * 1000) / frequency;

    // debug output
    printk("RTC ticks: %u, top: %u, freq: %u Hz, time_ms: %lld\n",
           rtc_ticks, top_value, frequency, rtc_time_ms);

    // calculate the offset between RTC time and system uptime
    new_offset_ms = rtc_time_ms - current_uptime_ms;

    // validate the offset (example: restrict offset to ±1 year for sanity)
    if (new_offset_ms < -ONE_YEAR_MS || new_offset_ms > ONE_YEAR_MS) {
        printk("offset out of range! calculation error\n");
        return -EINVAL;
    }

    // safely update the global offset
    k_mutex_lock(&offset_mutex, K_FOREVER);
    system_rtc_offset_ms = new_offset_ms;
    k_mutex_unlock(&offset_mutex);

    // debugging output
    printk("calculated offset (ms): %lld\n", system_rtc_offset_ms);

    return 0;
}

//  ========== app_rtc_get_time ======================================================================
uint64_t app_rtc_get_time()
{
    int64_t current_uptime_ms = k_uptime_get();
    int64_t offset_ms;

    // safely read the offset
    k_mutex_lock(&offset_mutex, K_FOREVER);
    offset_ms = system_rtc_offset_ms;
    k_mutex_unlock(&offset_mutex);

    // check for overflow or underflow
    if (offset_ms > 0 &&
        current_uptime_ms > UINT64_MAX - offset_ms) {
        printk("overflow detected in timestamp calculation\n");
        return UINT64_MAX;
    }
    if (offset_ms < 0 &&
        current_uptime_ms < (uint64_t)(-offset_ms)) {
        printk("underflow detected in timestamp calculation\n");
        return 0;
    }
    uint64_t timestamp_ms = current_uptime_ms + offset_ms;
    return timestamp_ms;
}

//  ========== app_rtc_periodic_sync==================================================================
int8_t app_rtc_periodic_sync(const struct device *rtc_dev)
{
    if (!rtc_dev) {
        printk("RTC device is NULL\n");
        return -EINVAL;
    }
    
    // call this periodically from a thread or workqueue
    int8_t ret = app_rtc_sync_uptime(rtc_dev);
    if (ret < 0) {
        printk("periodic sync failed, error: %d", ret);
    }
    return 0;
}
```

## src/app_rtc.h
```c
/*
 * Copyright (c) 2025
 * Regis Rousseau
 * Univ Lyon, INSA Lyon, Inria, CITI, EA3720
 * SPDX-License-Identifier: Apache-2.0
 */

#ifndef APP_RTC_H
#define APP_RTC_H

//  ========== includes ====================================================================
#include <zephyr/kernel.h>
#include <zephyr/device.h>
#include <zephyr/devicetree.h>
#include <zephyr/drivers/rtc.h>
#include <zephyr/drivers/counter.h>
#include <zephyr/sys_clock.h> 

//  ========== defines =====================================================================
#define ONE_YEAR_MS                 365LL * 24 * 60 * 60 * 1000
#define CONFIG_COUNTER_NRF_RTC

//  ========== prototypes ==================================================================
const struct device *app_rtc_init(void);
int8_t  app_rtc_sync_uptime(const struct device *i2c_dev);
uint64_t app_rtc_get_time();
int8_t app_rtc_periodic_sync(const struct device *rtc_dev);

#endif /* APP_RTC_H */
```
